ENTRY (_start)

SECTIONS
{
    . = 0x80000;

    .text : {
        KEEP(*(.text.boot))
        *(.text .text.* .gnu.linkonce.t*)
    }

    .rodata : ALIGN(16) {
        *(.rodata .rodata.* .gnu.linkonce.r*)
    }

    PROVIDE(_data = .);

    .data : ALIGN(16) {
        *(.data .data.* .gnu.linkonce.d*)
    }

    .bss (NOLOAD) : ALIGN(16) {
        PROVIDE(__bss_start_addr__ = .);
        *(.bss .bss.*)
        *(COMMON)
        . = ALIGN(16);
        PROVIDE(__bss_end_addr__ = .);
    }

    .init0_stack (NOLOAD) : ALIGN(16) {
        PROVIDE(__stack0_bottom_addr__ = .);
        . += 64K;
        PROVIDE(__stack0_top_addr__ = .);
    }

    _end = .;

    /DISCARD/ : {
       *(.comment)
       *(.gnu*)
       *(.note*)
       *(.eh_frame*)
    }
}